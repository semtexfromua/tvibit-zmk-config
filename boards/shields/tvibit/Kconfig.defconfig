## boards/shields/tvibit/Kconfig.defconfig
```kconfig
# Left half is the central (connects to the PC, hosts ZMK Studio).
if SHIELD_TVIBIT_LEFT

config ZMK_KEYBOARD_NAME
	default "Tvibit"            # must be < 16 characters

config ZMK_SPLIT_ROLE_CENTRAL
	default y

endif

if SHIELD_TVIBIT_LEFT || SHIELD_TVIBIT_RIGHT

config ZMK_SPLIT
	default y

endif

# OLED (SSD1306 over I2C) defaults, only pulled in when the display is enabled.
if ZMK_DISPLAY

config I2C
	default y

config SSD1306
	default y

choice ZMK_DISPLAY_WORK_QUEUE
	default ZMK_DISPLAY_WORK_QUEUE_DEDICATED
endchoice

endif
```

## boards/shields/tvibit/Kconfig.shield
```kconfig
# No whitespace after the comma or in the part name!
config SHIELD_TVIBIT_LEFT
	def_bool $(shields_list_contains,tvibit_left)

config SHIELD_TVIBIT_RIGHT
	def_bool $(shields_list_contains,tvibit_right)
```

## config/west.yml
```yaml
manifest:
  remotes:
    - name: zmkfirmware
      url-base: https://github.com/zmkfirmware
  projects:
    - name: zmk
      remote: zmkfirmware
      # Pinned to a stable release (main dropped the nice_nano_v2 board name).
      # Bump to a newer tag from https://github.com/zmkfirmware/zmk/releases when ready.
      revision: v0.3.0
      import: app/west.yml
  self:
    path: config
```
