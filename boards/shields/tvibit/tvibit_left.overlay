#include "tvibit.dtsi"

/*
 * ┌──────────────────────────────────────────────────────────────────┐
 * │  TODO: PLACEHOLDER PINS — no PCB yet.                              │
 * │  Replace the pin numbers below with your real hand-wiring once     │
 * │  decided. &pro_micro N = the Pro Micro / nice!nano logical pin N.  │
 * │  diode-direction = "col2row"  =>  cathode (stripe) of the diode    │
 * │  faces the ROW wire. 7 columns + 6 rows for this half.             │
 * └──────────────────────────────────────────────────────────────────┘
 */
&kscan0 {
	col-gpios
		= <&pro_micro 4  GPIO_ACTIVE_HIGH>
		, <&pro_micro 5  GPIO_ACTIVE_HIGH>
		, <&pro_micro 6  GPIO_ACTIVE_HIGH>
		, <&pro_micro 7  GPIO_ACTIVE_HIGH>
		, <&pro_micro 8  GPIO_ACTIVE_HIGH>
		, <&pro_micro 9  GPIO_ACTIVE_HIGH>
		, <&pro_micro 10 GPIO_ACTIVE_HIGH>
		;

	row-gpios
		= <&pro_micro 21 (GPIO_ACTIVE_HIGH | GPIO_PULL_DOWN)>
		, <&pro_micro 20 (GPIO_ACTIVE_HIGH | GPIO_PULL_DOWN)>
		, <&pro_micro 19 (GPIO_ACTIVE_HIGH | GPIO_PULL_DOWN)>
		, <&pro_micro 18 (GPIO_ACTIVE_HIGH | GPIO_PULL_DOWN)>
		, <&pro_micro 15 (GPIO_ACTIVE_HIGH | GPIO_PULL_DOWN)>
		, <&pro_micro 14 (GPIO_ACTIVE_HIGH | GPIO_PULL_DOWN)>
		;
};
